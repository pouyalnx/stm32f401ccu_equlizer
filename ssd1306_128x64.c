/*-----------------------------------------------------------------------------
this driver designed for simpler usage of OLED device

how use:
extern void stdout_goxy_oled(int x,int y);
extern void stdout_write_oled(char *data);
extern int stdout_putchar_oled(int ch);

extern void stdout_goxy(int x,int y);
extern int stdout_putchar(int ch);


bring this functions to ur app but remember u should call stdout functions at least 100ms
after power on oled inner device need to init

---------------------------------------------------------------------------*/
#include "Driver_I2C.h"
extern void stdout_goxy_oled(int x,int y);
extern void stdout_write_oled(char *data);
extern int stdout_putchar_oled(int ch);

//extern void stdout_goxy(int x,int y);
//extern int stdout_putchar(int ch);
////////////////////////////////////////////////////////////////////////////////


int stdout_putchar(int ch){return stdout_putchar_oled(ch);}
void stdout_goxy(int x,int y){stdout_goxy_oled(x,y);}




////////////////////////////////////////////////////////////////////////////////
#define I2C_DRVIER			 Driver_I2C1 //PLEASE CHANGE HERE FOR USING DIFRENT
#define COLUMN 	128
#define PAGE		8	
extern ARM_DRIVER_I2C 		 I2C_DRVIER;
static unsigned char buffer[32];


/////////////////////////////////////////////////////////
#define i2c_init					unsigned int i 
#define i2c_start					i=0
#define i2c_write(byte)			buffer[i++]=byte
#define i2c_stop(flg)			drv_write(buffer,i,flg)
/////////////////////////////////////////////////////////
static ARM_DRIVER_I2C *drv;
static bool isInitated=false;
static int column,page;
extern const unsigned char font[];
static void stdout_init_oled(void);
/////////////////////////////////////////////////////////

static void drv_write(void *data,unsigned int size,bool continue_req){
  drv->MasterTransmit(0X78>>1,data,size,continue_req);	
  while(drv->GetStatus().busy);  //wait for last transfer
}


//////////////////////////////////////////////////////////
void stdout_goxy_oled(int x,int y){
	page=x;//x%PAGE;
	column=0;//(y*font[2])%COLUMN;
}

void stdout_write_oled(char *data){
	int gpv0,zero_cnt;	
	if(isInitated==false){
		stdout_init_oled();
		isInitated=true;
	}
	i2c_init;
	i2c_start;
	i2c_write(0x80);
	i2c_write(0xb0|(page&0xf));
	i2c_write(0x80);
	i2c_write(column&0xf);
	i2c_write(0x80);
	i2c_write(0x10|((column>>4)&0xf));
	i2c_write(0x40);
	
	zero_cnt=0;
	column+=font[2];
	if((COLUMN-column)<font[2]){
		zero_cnt=COLUMN-column;
		column=0;
		page+=1;
		if(page==PAGE) page=0;
	}
	
	
	for(gpv0=0;gpv0<font[2];gpv0++)  i2c_write(data[gpv0]);
	while(zero_cnt--)					   i2c_write(0);
	i2c_stop(false);
}


int stdout_putchar_oled(int ch){	
	int start_ptr,gpv0,zero_cnt;
	if(!isInitated){
		stdout_init_oled();
		isInitated=true;
	}
	if(ch=='\b'){
		if(column!=0){
			column-=font[2];
			stdout_putchar_oled(' ');
			column-=font[2];
		}
		else{
		   column=(COLUMN/font[2]-1)*font[2];
			if(page==0) page=PAGE-1;
			else			page-=1;
			stdout_putchar_oled(' ');
			column=(COLUMN/font[2]-1)*font[2];
			if(page==0) page=PAGE-1;
			else			page-=1;
		}
		return ch;
	}
	if(ch=='\n' || ch=='\r'){
		start_ptr=page;
		while(start_ptr==page) stdout_putchar_oled(' ');
		return ch;
	}
	if(ch=='\t'){
		zero_cnt=4-(column/font[2])%4;
		while(zero_cnt--) stdout_putchar_oled(' ');
		return ch;
	}
	if(ch<font[4] || ch>(font[4]+font[5])) ch='?';
	
	i2c_init;
	i2c_start;
	i2c_write(0x80);
	i2c_write(0xb0|(page&0xf));
	i2c_write(0x80);
	i2c_write(column&0xf);
	i2c_write(0x80);
	i2c_write(0x10|((column>>4)&0xf));
	i2c_write(0x40);
	
	zero_cnt=0;
	column+=font[2];
	if((COLUMN-column)<font[2]){
		zero_cnt=COLUMN-column;
		column=0;
		page+=1;
		if(page==PAGE) page=0;
	}
	
	
	start_ptr=6+(ch-font[4])*font[2];
	for(gpv0=0;gpv0<font[2];gpv0++)  i2c_write(font[gpv0+start_ptr]);
	while(zero_cnt--)					   i2c_write(0);
	i2c_stop(false);
	
	return ch;
}

/////////////////////////////////////////////////////////
static void stdout_init_oled(void){
	i2c_init;
	drv=&I2C_DRVIER;
	drv->Initialize(NULL);
	drv->PowerControl(ARM_POWER_FULL);	
	drv->Control(ARM_I2C_BUS_SPEED,ARM_I2C_BUS_SPEED_FAST);
	
	//delay 100ms

	i2c_start;
	i2c_write(0x80);
	i2c_write(0xae);
	i2c_stop(true);

	i2c_start;
	i2c_write(0x20);
	i2c_write(0x2);
	i2c_stop(true);

	i2c_start;
	i2c_write(0x80);
	i2c_write(0xb0);
	i2c_stop(true);

	i2c_start;
	i2c_write(0x80);
	i2c_write(0xc8);
	i2c_stop(true);

	i2c_start;
	i2c_write(0x80);
	i2c_write(0x0);
	i2c_stop(true);

	i2c_start;
	i2c_write(0x80);
	i2c_write(0x10);
	i2c_stop(true);

	i2c_start;
	i2c_write(0x80);
	i2c_write(0x40);
	i2c_stop(true);


	i2c_start;
	i2c_write(0x80);
	i2c_write(0xa1);
	i2c_stop(true);

	i2c_start;
	i2c_write(0x80);
	i2c_write(0xa6);
	i2c_stop(true);

	i2c_start;
	i2c_write(0x80);
	i2c_write(0xa4);
	i2c_stop(true);


	i2c_start;
	i2c_write(0);
	i2c_write(0xd5);
	i2c_write(0xf0);
	i2c_stop(true);

	i2c_start;
	i2c_write(0);
	i2c_write(0xd9);
	i2c_write(0xf1);
	i2c_stop(true);

	i2c_start;
	i2c_write(0);
	i2c_write(0xda);
	i2c_write(0x12);
	i2c_stop(true);

	i2c_start;
	i2c_write(0);
	i2c_write(0xdb);
	i2c_write(0x40);
	i2c_stop(true);


	i2c_start;
	i2c_write(0);
	i2c_write(0x8d);
	i2c_write(0x14);
	i2c_stop(true);

	i2c_start;
	i2c_write(0x80);
	i2c_write(0xaf);
	i2c_stop(true);


	i2c_start;
	i2c_write(0);
	i2c_write(0x81);
	i2c_write(0xff);
	i2c_stop(false);
	
	column=0;
	page=0;
}




////////////////////////////////////////////////////////////////////////
#ifndef __font
#define __font
const unsigned char font[]={
    0x0, 0x1, // size of one indicates fixed font width and no pixel padding
    0x08, // width
    0x08, // height
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0x00,0x00,0x04,0x02,0x04,0x02,0x00,0x00,  // ~
};
#endif






